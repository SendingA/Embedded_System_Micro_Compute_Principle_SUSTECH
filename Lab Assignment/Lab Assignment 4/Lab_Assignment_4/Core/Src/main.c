/* USER CODE BEGIN Header */
/**
  ******************************************************************************
  * @file           : main.c
  * @brief          : Main program body
  ******************************************************************************
  * @attention
  *
  * Copyright (c) 2022 STMicroelectronics.
  * All rights reserved.
  *
  * This software is licensed under terms that can be found in the LICENSE file
  * in the root directory of this software component.
  * If no LICENSE file comes with this software, it is provided AS-IS.
  *
  ******************************************************************************
  */
/* USER CODE END Header */
/* Includes ------------------------------------------------------------------*/
#include "main.h"

/* Private includes ----------------------------------------------------------*/
/* USER CODE BEGIN Includes */

/* Private includes ----------------------------------------------------------*/
/* USER CODE BEGIN Includes */
#include "sys.h"
#include "delay.h"
#include "stdlib.h"
//#include "usart.h"
#include "led.h"
#include "key.h"
#include "lcd.h"
//#include "usmart.h"
#include "touch.h"
#include "24cxx.h"
#include "24l01.h" //通信驱动 基于spi进行通信
/* USER CODE END Includes */

/* Private typedef -----------------------------------------------------------*/
/* USER CODE BEGIN PTD */

/* USER CODE END PTD */

/* Private define ------------------------------------------------------------*/
/* USER CODE BEGIN PD */
unsigned char DATA_TO_SEND[800];
int state_num = 0;
u8 STATE[30];
UART_HandleTypeDef huart1;

const unsigned char gImage_barrier[2088] = { 0X00,0X10,0X1A,0X00,0X28,0X00,0X01,0X1B,
0X00,0X00,0XFF,0XFF,0XFF,0XFF,0XFF,0XFF,0XFF,0XFF,0XFF,0XFF,0XFF,0XFF,0XFF,0XFF,
0XFF,0XFF,0XFF,0XFF,0XFF,0XFF,0XFF,0XFF,0XFF,0XFF,0XFF,0XFF,0XFF,0XFF,0XFF,0XFF,
0XFF,0XFF,0XFF,0XFF,0XFF,0XFF,0XFF,0XFF,0XFF,0XFF,0XFF,0XFF,0XFF,0XFF,0XFF,0XFF,
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0XFF,0XFF,0XFF,0XFF,0XFF,0XFF,0XFF,0XFF,0X7D,0XEF,0XFF,0XFF,0XFF,0XFF,0XFF,0XFF,
};
const unsigned char gImage_player[1768] = { 0X00,0X10,0X28,0X00,0X16,0X00,0X01,0X1B,
0X00,0X00,0XFF,0XFF,0XFF,0XFF,0XFF,0XFF,0XFF,0XFF,0XFF,0XFF,0XFF,0XFF,0XFF,0XFF,
0XFF,0XFF,0XFF,0XFF,0XFF,0XFF,0XFF,0XFF,0XFF,0XFF,0XFF,0XFF,0XFF,0XFF,0XFF,0XFF,
0XFF,0XFF,0XFF,0XFF,0XFF,0XFF,0XFF,0XFF,0XFF,0XFF,0XFF,0XFF,0XFF,0XFF,0XFF,0XFF,
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0XA1,0X39,0X82,0X29,0X27,0X09,0X06,0X09,0X06,0X01,0X05,0X09,0XC4,0X08,0XA3,0X08,
};

const unsigned char gImage_dinosaur[2960] = { /* 0X00,0X10,0X28,0X00,0X25,0X00,0X01,0X1B, */
0XBE,0XF7,0XBE,0XF7,0XBE,0XF7,0XBE,0XF7,0XBE,0XF7,0XBE,0XF7,0XBE,0XF7,0XBE,0XF7,
0XBE,0XF7,0XBE,0XF7,0XBE,0XF7,0XBE,0XF7,0XBE,0XF7,0XBE,0XF7,0XBE,0XF7,0XBE,0XF7,
0XBE,0XF7,0XBE,0XF7,0XBE,0XF7,0XBE,0XF7,0XBE,0XF7,0XBE,0XF7,0XBE,0XF7,0XBE,0XF7,
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0XBE,0XF7,0XBE,0XF7,0XBE,0XF7,0XBE,0XF7,0XBE,0XF7,0XBE,0XF7,0XBE,0XF7,0XBE,0XF7,
};

const unsigned char gImage_dinosaur_jump[2880] = { /* 0X00,0X10,0X24,0X00,0X28,0X00,0X01,0X1B, */
0XBE,0XF7,0XBE,0XF7,0XBE,0XF7,0XBE,0XF7,0XBE,0XF7,0XBE,0XF7,0XBE,0XF7,0XBE,0XF7,
0XBE,0XF7,0XBE,0XF7,0XBE,0XF7,0XBE,0XF7,0XBE,0XF7,0XBE,0XF7,0XBE,0XF7,0XBE,0XF7,
0XBE,0XF7,0XBE,0XF7,0XBE,0XF7,0XBE,0XF7,0XBE,0XF7,0XBE,0XF7,0XBE,0XF7,0XBE,0XF7,
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0XBE,0XF7,0XBE,0XF7,0XBE,0XF7,0XBE,0XF7,0XBE,0XF7,0XBE,0XF7,0XBE,0XF7,0XBE,0XF7,
};



const unsigned char gImage_plane[2560] = { /* 0X00,0X10,0X28,0X00,0X20,0X00,0X01,0X1B, */
0X00,0X00,0X00,0X00,0X00,0X00,0X00,0X00,0X00,0X00,0X00,0X00,0X00,0X00,0X00,0X00,
0X00,0X00,0X00,0X00,0X00,0X00,0X00,0X00,0X00,0X00,0X00,0X00,0X00,0X00,0X00,0X00,
0X00,0X00,0X00,0X00,0X00,0X00,0X00,0X00,0X00,0X00,0X00,0X00,0X00,0X00,0X00,0X00,
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0X00,0X00,0X00,0X00,0X00,0X00,0X00,0X00,0X00,0X00,0X00,0X00,0X00,0X00,0X00,0X00,
};




const unsigned char gImage_missile[960] = { /* 0X00,0X10,0X0C,0X00,0X28,0X00,0X01,0X1B, */
0X00,0X00,0X00,0X00,0X00,0X00,0X00,0X00,0X00,0X00,0X00,0X00,0X00,0X00,0X00,0X00,
0X00,0X00,0X00,0X00,0X00,0X00,0X00,0X00,0X00,0X00,0X00,0X00,0X00,0X00,0X00,0X00,
0X00,0X00,0X00,0X00,0X00,0X00,0X00,0X00,0X00,0X00,0X00,0X00,0X00,0X00,0X00,0X00,
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0X60,0X08,0X00,0X31,0X60,0X20,0X60,0X08,0X00,0X00,0X00,0X00,0X00,0X00,0X00,0X00,
};


// 定义屏幕宽度和高度
#define SCREEN_WIDTH 240
#define SCREEN_HEIGHT 320

// 障碍物的宽度和高度
uint16_t OBSTACLE_WIDTH;
uint16_t OBSTACLE_HEIGHT;
// 障碍物速度
#define OBSTACLE_SPEED 1
#define MAX_SPEED 10
#define MIN_SPEED -10

uint32_t last_slide_time = 0; // 上一次滑动的时间戳
uint32_t last_update_time = 0; // 上次速度更新的时间戳
#define INERTIA_DECAY 1   // 惯性衰减（每秒减速量）
#define SLIDE_TIMEOUT 2000   // 停止滑动后的超时时间（ms）
#define WINDOW_TIMEOUT 1000

//选手的宽度和高度
uint16_t PLAYER_WIDTH;
uint16_t PLAYER_HEIGHT;
#define JUMP_TIMEOUT 1000
#define TERMINAL 10
////飞机大战参数
//#define PLANE_WIDTH 40
//#define PLANE_HEIGHT 32
//
//#define MISSILE_WIDTH 12
//#define MISSILE_HEIGHT 40
uint8_t level = 0;
uint8_t mode = 0;
int16_t speed = 0;
uint16_t timer = 0;
// 按钮参数
const uint16_t screen_width = 240;  // 假设屏幕宽度为 240 像素
const uint16_t screen_height = 320; // 假设屏幕高度为 320 像素
const uint16_t button_width = 60;   // 每个按钮的宽度
const uint16_t button_height = 30;  // 每个按钮的高度
const uint8_t corner_radius = 10;   // 按钮圆角半径
uint8_t jump = 0;
uint32_t last_jump_time = 0;

// 定义人物初始位置
int16_t player_x ; // 人物起始位置（水平居中）
uint16_t player_y ;   // 人物起始位置（靠近底部）

// 障碍物结构体
typedef struct {
    int16_t x; // 障碍物的 x 坐标
    int16_t y; // 障碍物的 y 坐标
    uint16_t color; // 障碍物的颜色
} Obstacle;

// 障碍物数组
#define MAX_OBSTACLES 3
Obstacle obstacles[MAX_OBSTACLES];


// 用于存储触摸点的起始和当前坐标
static int16_t start_x = -1, start_y = -1; // 触摸起点
static int16_t current_x = -1, current_y = -1; // 当前触摸点

// 滑动方向枚举
typedef enum {
    SLIDE_NONE,
    SLIDE_UP,
    SLIDE_DOWN,
    SLIDE_LEFT,
    SLIDE_RIGHT
} SlideDirection;


// 滑动事件队列
#define SLIDE_HISTORY_SIZE 10
typedef struct {
    uint32_t timestamp;       // 滑动时间戳
    SlideDirection direction; // 滑动方向
} SlideEvent;
SlideEvent slide_history[SLIDE_HISTORY_SIZE] = {0}; // 存储滑动时间和方向
uint8_t slide_index = 0;

// 随机数初始化
void Random_Init() {
    srand(HAL_GetTick()); // 使用当前系统时间作为随机种子
}


// 用于检查两个矩形是否重叠
uint8_t Check_Overlap(Obstacle a, Obstacle b) {
    return (a.x < b.x + OBSTACLE_WIDTH &&
            a.x + OBSTACLE_WIDTH > b.x &&
            a.y < b.y + OBSTACLE_HEIGHT &&
            a.y + OBSTACLE_HEIGHT > b.y);
}



void Init_Obstacles() {
	if(mode == 1){
		OBSTACLE_WIDTH = 12;
		OBSTACLE_HEIGHT = 40;
	}else{
		OBSTACLE_WIDTH = 20;
		OBSTACLE_HEIGHT = 20;
	}
    for (int i = 0; i < MAX_OBSTACLES; i++) {
        uint8_t overlap; // 标志变量，用于检查是否重叠
        do {
            overlap = 0;

            // 随机生成障碍物的坐标和颜色
            obstacles[i].x = rand() % (SCREEN_WIDTH - OBSTACLE_WIDTH);
            obstacles[i].y = - rand() % (2 * OBSTACLE_HEIGHT);
            obstacles[i].color = (rand() % 2) ? RED : GREEN;

            // 检查是否与已有的障碍物发生重叠
            for (int j = 0; j < i; j++) {
                if (Check_Overlap(obstacles[i], obstacles[j])== 1) {
                    overlap = 1; // 如果发生重叠，重新生成
                    break;
                }
            }
        } while (overlap); // 如果重叠，则重新生成
    }
}



// 绘制人物
void Draw_Player(int x, int y) {
	uint32_t current_time = HAL_GetTick();
	if(mode == 0){
		if(current_time - last_jump_time > JUMP_TIMEOUT){
			LCD_ShowPic(x,y,PLAYER_WIDTH,PLAYER_HEIGHT,gImage_dinosaur);
		}else{
			LCD_ShowPic(x,y,PLAYER_WIDTH,PLAYER_HEIGHT,gImage_dinosaur_jump);
		}
	}else{
//		PLAYER_WIDTH = 40;
//		PLAYER_HEIGHT = 32;
		if(current_time - last_jump_time > JUMP_TIMEOUT){
			LCD_ShowPic(x,y,PLAYER_WIDTH,PLAYER_HEIGHT,gImage_plane);
		}else{
			LCD_ShowPic(x,y,PLAYER_WIDTH,PLAYER_HEIGHT,gImage_dinosaur_jump);
		}
	}
}

// 清除人物
void Clear_Player(int x, int y) {
	uint32_t current_time = HAL_GetTick();
	if(mode == 0){
		if(current_time - last_jump_time > JUMP_TIMEOUT){
			LCD_Fill(x, y, x + PLAYER_WIDTH, y + PLAYER_HEIGHT, WHITE); // 用背景色覆盖人物
		}else{
			LCD_Fill(x, y, x + PLAYER_HEIGHT - 1, y + PLAYER_WIDTH, WHITE); // 用背景色覆盖人物
		}
    }else{
    	if(current_time - last_jump_time > JUMP_TIMEOUT){
    		LCD_Fill(x, y, x + PLAYER_WIDTH, y + PLAYER_HEIGHT, BLACK); // 用背景色覆盖人物
    	}else{
    		LCD_Fill(x, y, x + PLAYER_WIDTH, y + PLAYER_HEIGHT, BLACK); // 用背景色覆盖人物
    	}
    }
}




// 绘制障碍物
void Draw_Obstacle(Obstacle *obstacle) {
	if((obstacle->x >= 0)&(obstacle->x <= 240)&(obstacle->y >= 0)&(obstacle->y <= SCREEN_HEIGHT - 10 - button_height - OBSTACLE_HEIGHT)){
		if(mode == 0){
			LCD_Fill(obstacle->x, obstacle->y, obstacle->x + OBSTACLE_WIDTH - 1, obstacle->y + OBSTACLE_HEIGHT - 1, obstacle->color);
		}else{
			LCD_ShowPic(obstacle->x, obstacle->y, OBSTACLE_WIDTH, OBSTACLE_HEIGHT, gImage_missile);
		}
  }
}

// 更新障碍物位置
void Update_Obstacles() {
    if(level >= TERMINAL * MAX_OBSTACLES){
    	if(timer <= 120){
			LCD_ShowString(100, 150, 12 * 9, 24, 24, "YOU WIN !");
    	}else{
			LCD_ShowString(100, 150, 12 * 9, 24, 24, "TIME OUT!");
    	}
		return;
    }
    for (int i = 0; i < MAX_OBSTACLES; i++) {
        // 如果障碍物已超出屏幕，则重新生成
        if (obstacles[i].y >= SCREEN_HEIGHT + 10 * OBSTACLE_HEIGHT) {
            obstacles[i].x = rand() % (SCREEN_WIDTH - OBSTACLE_WIDTH); // 随机生成 x 坐标
            obstacles[i].y = - rand() %  (2*OBSTACLE_HEIGHT); // 障碍物重新出现在屏幕上方
            level = level + 1;
        } else {
        	//检测是否发生碰撞
        	if(player_x < obstacles[i].x + OBSTACLE_WIDTH
        			&& player_x + PLAYER_WIDTH > obstacles[i].x
					&&  player_y < obstacles[i].y + OBSTACLE_HEIGHT
					&& player_y + PLAYER_HEIGHT > obstacles[i].y ){
        		uint32_t current_time = HAL_GetTick();
        		//检测是否处于跳跃状态
        		if(current_time - last_jump_time > JUMP_TIMEOUT){
        			speed = 0;
        	    	LCD_ShowString(100, 150, 12 * 8, 24, 24, "YOU LOSE");
//        	    	level = 0;
        		}else{
            		obstacles[i].y += speed; // 跳跃状态
            		Draw_Player(player_x, player_y);
        		}
        	}else{
        		obstacles[i].y += speed; // 向下移动
            }
        }

        Draw_Obstacle(&obstacles[i]); // 绘制障碍物
    }
}

// 清除障碍物区域
void Clear_Obstacles() {
    for (int i = 0; i < MAX_OBSTACLES; i++) {
    	if(mode == 0)
    	{
    		if((obstacles[i].x >= 0)&(obstacles[i].x <= 240)&(obstacles[i].y >= 0)&(obstacles[i].y <= SCREEN_HEIGHT - 10 - button_height - OBSTACLE_HEIGHT) ){
    			LCD_Fill(obstacles[i].x, obstacles[i].y, obstacles[i].x + OBSTACLE_WIDTH - 1, obstacles[i].y + OBSTACLE_HEIGHT - 1, WHITE);
    		}
    	}else{
    		if((obstacles[i].x >= 0)&(obstacles[i].x <= 240)&(obstacles[i].y >= 0)&(obstacles[i].y <= SCREEN_HEIGHT - 10 - button_height - OBSTACLE_HEIGHT) ){
    		    			LCD_Fill(obstacles[i].x, obstacles[i].y, obstacles[i].x + OBSTACLE_WIDTH - 1, obstacles[i].y + OBSTACLE_HEIGHT - 1, BLACK);
    		    		}
    	}
    }
}





// 添加滑动事件到队列
void Record_Slide_Event(SlideDirection direction) {
    uint32_t timestamp = HAL_GetTick();
    slide_history[slide_index].timestamp = timestamp;
    slide_history[slide_index].direction = direction;
    slide_index = (slide_index + 1) % SLIDE_HISTORY_SIZE;
    // 更新最后滑动时间
    last_slide_time = timestamp;
}


// 分析滑动事件，计算速度增量
int Analyze_Slide_Events(void) {
    uint32_t now = HAL_GetTick();
    int16_t delta_speed = 0;

    // 遍历滑动事件队列，计算在 timeout 窗口内的速度增量
    for (uint8_t i = 0; i < SLIDE_HISTORY_SIZE; i++) {
        if ((slide_history[i].timestamp > 0) && (now - slide_history[i].timestamp <= WINDOW_TIMEOUT)) {
            if (slide_history[i].direction == SLIDE_UP) {
                delta_speed += 1; // 上滑增加速度
            } else if (slide_history[i].direction == SLIDE_DOWN) {
                delta_speed -= 1; // 下滑减少速度
            }
        }
    }

    return delta_speed;
}

// 更新速度
void Update_Speed(void) {
    uint32_t now = HAL_GetTick();

    // 如果有滑动操作，根据方向和频率调整速度
    if (now - last_slide_time <= SLIDE_TIMEOUT) {
    	if(now - last_update_time >= WINDOW_TIMEOUT){
			int16_t delta_speed = Analyze_Slide_Events();
			// 根据滑动影响调整速度
			speed += delta_speed ;
			if (speed > MAX_SPEED) speed = MAX_SPEED;
			if (speed < MIN_SPEED) speed = MIN_SPEED;
		    last_update_time = now;
    	}
    } else {
        // 停止滑动后，模拟惯性减速
//        uint32_t elapsed_time = (now - last_update_time) / 1000.0;
        if (speed > 0) {
//            speed -= INERTIA_DECAY * elapsed_time; // 前进方向减速
        	speed -= 0.5;
            if (speed < 0) speed = 0;
        } else if (speed < 0) {
//            speed += INERTIA_DECAY * elapsed_time; // 后退方向减速
        	speed += 0.5;
            if (speed > 0) speed = 0;
        }
    }
    // 当速度为 0 时显示提示信息
    if (speed == 0) {
        LCD_ShowString(0, 0, 200, 16, 16, "Stopped ");
    }else if(speed > 0){
        LCD_ShowString(0, 0, 200, 16, 16, "Forward ");
    }else{
        LCD_ShowString(0, 0, 200, 16, 16, "Backward");
    }
}


/* USER CODE END PD */

/* Private macro -------------------------------------------------------------*/
/* USER CODE BEGIN PM */
//清空屏幕并在右上角显�?"RST"
void Load_Drow_Dialog(void)
{
 	POINT_COLOR=BLUE;//设置字体为蓝�?
	LCD_ShowString(lcddev.width-24,0,200,16,16,"RST");//显示清屏区域
  	POINT_COLOR=BLUE;//设置画笔蓝色
  	Draw_Dashed_Line(120, 0, 320, 30, 10);
  	uint16_t button_y = screen_height - button_height - 5; // 按钮的 Y 坐标

    // 按钮颜色
    uint16_t button_color = RED;
    uint16_t text_color = WHITE;

// 	POINT_COLOR=WHITE;
    // 绘制 "LEFT" 按钮
    uint16_t left_x1 = 10;
    uint16_t left_x2 = left_x1 + button_width;
    LCD_DrawButton(left_x1, button_y, left_x2, button_y + button_height, corner_radius, button_color, "LEFT", text_color);

    button_color = YELLOW;
    // 绘制 "RIGHT" 按钮
    uint16_t right_x1 = screen_width - button_width - 10;
    uint16_t right_x2 = right_x1 + button_width;
    LCD_DrawButton(right_x1, button_y, right_x2, button_y + button_height, corner_radius, button_color, "RIGHT", text_color);

    button_color = GREEN;
    // 绘制 "JUMP" 按钮
    uint16_t jump_x1 = (screen_width - button_width) / 2;
    uint16_t jump_x2 = jump_x1 + button_width;
    LCD_DrawButton(jump_x1, button_y, jump_x2, button_y + button_height, corner_radius, button_color, "JUMP", text_color);
    //My dinosaur
    Draw_Player(player_x,player_y);

}


void Draw_Dashed_Line(uint16_t x, uint16_t y_start, uint16_t y_end, uint16_t dash_length, uint16_t gap_length) {
    uint16_t y = y_start;

    while (y < y_end) {
        uint16_t y_dash_end = y + dash_length;
        if (y_dash_end > y_end) {
            y_dash_end = y_end;
        }

        // 绘制一段线
        LCD_DrawLine(x, y, x, y_dash_end); // 在LCD上绘制一段线

        // 跳过间隔部分
        y = y_dash_end + gap_length;
    }
}

void LCD_FillRoundedRectangle(uint16_t sx, uint16_t sy, uint16_t ex, uint16_t ey, uint16_t radius, uint16_t color) {
    // 填充矩形中间部分
    LCD_Fill(sx + radius, sy, ex - radius, ey, color);

    // 填充矩形顶部和底部的中间部分
    LCD_Fill(sx, sy + radius, ex, ey - radius, color);

    // 绘制并填充四个圆角
    for (int y = 0; y < radius; y++) {
        for (int x = 0; x < radius; x++) {
            if ((x * x + y * y) <= (radius * radius)) {
                LCD_Fast_DrawPoint(sx + radius - x, sy + radius - y, color); // 左上
                LCD_Fast_DrawPoint(sx + radius - x, ey - radius + y, color); // 左下
                LCD_Fast_DrawPoint(ex - radius + x, sy + radius - y, color); // 右上
                LCD_Fast_DrawPoint(ex - radius + x, ey - radius + y, color); // 右下
            }
        }
    }
}

void LCD_DrawButton(uint16_t sx, uint16_t sy, uint16_t ex, uint16_t ey, uint16_t radius, uint16_t color, const char *text, uint16_t text_color) {
	// 绘制圆角矩形并填充颜色
    LCD_FillRoundedRectangle(sx, sy, ex, ey, radius, color);
    // 在按钮中心显示文字
    uint16_t text_x = sx + ((ex - sx) - (strlen(text) * 8)) / 2; // 文字居中
    uint16_t text_y = sy + ((ey - sy) - 16) / 2;                // 文字垂直居中
    LCD_ShowString2(text_x, text_y, 40, 20, 16, (uint8_t *)text);

}






void screen_norm_print(){
//	LCD_Clear(WHITE);//清屏
	POINT_COLOR=BLUE;//设置字体为蓝色
	LCD_ShowString(lcddev.width-24,0,200,16,16,"RST");//显示清屏区域
	LCD_ShowString(0,0,200,24,24, "SHOW PICTURE");
	LCD_ShowString(60,60,200,24,24, "SEND MESSAGE");
	LCD_ShowString(0, lcddev.height-24, 200, 16, 16, STATE);
	POINT_COLOR=RED;//设置画笔为红色

}

// 检测滑动方向
SlideDirection Detect_Slide_Direction(int16_t start_x, int16_t start_y, int16_t current_x, int16_t current_y) {
    int16_t dx = current_x - start_x;
    int16_t dy = current_y - start_y;

    // 设置滑动阈值，避免误判
    int16_t threshold = 20; // 像素

    if (abs(dx) > abs(dy)) {
        if (dx > threshold) {
            return SLIDE_RIGHT; // 向右滑动
        } else if (dx < -threshold) {
            return SLIDE_LEFT; // 向左滑动
        }
    } else {
        if (dy > threshold) {
            return SLIDE_DOWN; // 向下滑动
        } else if (dy < -threshold) {
            return SLIDE_UP; // 向上滑动
        }
    }

    return SLIDE_NONE; // 未检测到滑动
}

void reset(){
	  if(mode == 0){
		  LCD_Clear(WHITE);
			PLAYER_WIDTH = 40;
			PLAYER_HEIGHT = 37;
	  }else{
		  	LCD_Clear(BLACK);
			PLAYER_WIDTH = 40;
			PLAYER_HEIGHT = 32;
	  }
	  player_x = (screen_width - button_width) / 2; // 人物起始位置（水平居中）
	  player_y = screen_height - button_height - 10 - PLAYER_HEIGHT;   // 人物起始位置（靠近底部）
	  Draw_Player(player_x, player_y);
	  Init_Obstacles(); // 初始化障碍物
	  Load_Drow_Dialog();
	  last_update_time = HAL_GetTick();
	  level = 0;
	  speed = 0;
	  timer = 0;
}

//电阻触摸屏测试函�?
void rtp_test(void)
{
	u8 key;
	u8 i=0;

	while(1)
	{
	    Clear_Obstacles(); // 清除原来障碍物的区域
	    Update_Obstacles(); // 更新障碍物位置
	  	Draw_Dashed_Line(120, 0, 320, 30, 10);
        char level_str[20];
        sprintf(level_str, "Level: %d", level/MAX_OBSTACLES);
        LCD_ShowString(lcddev.width-72,20, 200, 16, 16, level_str);
        char timer_str[20];
        sprintf(timer_str, "Time: %d", timer);
        LCD_ShowString(lcddev.width-72,40, 200, 16, 16, timer_str);
	 	key=KEY_Scan(0);
		tp_dev.scan(0);
		 // 检测触摸按下
		if (tp_dev.sta & TP_PRES_DOWN) {
			if (start_x == -1 && start_y == -1) {
				// 记录起始坐标
				start_x = tp_dev.x[0];
				start_y = tp_dev.y[0];
			} else {
				// 记录当前坐标
				current_x = tp_dev.x[0];
				current_y = tp_dev.y[0];
			}
			if((tp_dev.x[0] >= 10&&tp_dev.x[0] <= 70) && (tp_dev.y[0] >= 280&&tp_dev.y[0] <= 310)){
				// 点击了 LEFT 按钮，人物左移
				Clear_Player(player_x, player_y); // 清除旧位置
				player_x -= 20;                   // 左移20像素
				if (player_x < 0) player_x = 0;   // 边界检测
				Draw_Player(player_x, player_y); // 绘制新位置
			}else if((tp_dev.x[0] >= 170&&tp_dev.x[0] <= 230) && (tp_dev.y[0] >= 280&&tp_dev.y[0] <= 310)){
				// 点击了 RIGHT 按钮，人物右移
				Clear_Player(player_x, player_y); // 清除旧位置
				player_x += 20;                   // 左移20像素
				if (player_x > SCREEN_WIDTH - PLAYER_WIDTH) player_x = SCREEN_WIDTH - PLAYER_WIDTH ;   // 边界检测
				Draw_Player(player_x, player_y); // 绘制新位置
			}else if((tp_dev.x[0] >= 90&&tp_dev.x[0] <= 150) && (tp_dev.y[0] >= 280&&tp_dev.y[0] <= 310)){
				// 点击了 RIGHT 按钮，人物右移
//				Clear_Player(player_x, player_y); // 清除旧位置
//				player_x += 20;                   // 左移20像素
//				Draw_Player(player_x, player_y); // 绘制新位置
				jump = 1;
				last_jump_time = HAL_GetTick();
				LCD_ShowPic(player_x,player_y,PLAYER_WIDTH,PLAYER_HEIGHT,gImage_dinosaur_jump);

			}
		}


		// 检测触摸松开
		if ((tp_dev.sta & TP_PRES_DOWN) == 0 && start_x != -1 && start_y != -1) {
			// 检测滑动方向
			SlideDirection direction = Detect_Slide_Direction(start_x, start_y, current_x, current_y);
			// 根据滑动方向执行操作
			switch (direction) {
				case SLIDE_UP:
					LCD_ShowString(lcddev.width-40,0,200,16,16,"UP   ");//显示清屏区域
					break;
				case SLIDE_DOWN:
					LCD_ShowString(lcddev.width-40,0,200,16,16,"DOWN ");//显示清屏区域
					break;
				case SLIDE_LEFT:
					LCD_ShowString(lcddev.width-40,0,200,16,16,"LEFT ");//显示清屏区域
					Clear_Player(player_x, player_y); // 清除旧位置
					player_x -= 20;                   // 左移20像素
					if (player_x < 0) player_x = 0;   // 边界检测
					Draw_Player(player_x, player_y); // 绘制新位置
					break;
				case SLIDE_RIGHT:
					LCD_ShowString(lcddev.width-40,0,200,16,16,"RIGHT");//显示清屏区域
					Clear_Player(player_x, player_y); // 清除旧位置
					player_x += 20;                   // 左移20像素
					if (player_x > SCREEN_WIDTH - PLAYER_WIDTH) player_x = SCREEN_WIDTH - PLAYER_WIDTH ;   // 边界检测
					Draw_Player(player_x, player_y); // 绘制新位置
					break;
				default:
					break;
			}
            if (direction == SLIDE_UP || direction == SLIDE_DOWN) {
                Record_Slide_Event(direction);  // 记录滑动事件
            }

			// 重置触摸点
			start_x = -1;
			start_y = -1;
			current_x = -1;
			current_y = -1;
		}
        // 更新速度
        Update_Speed();
        LCD_ShowString(0, 20, 200, 16, 16, "Speed:    ");
        // 显示当前速度
        char speed_str[20];
        sprintf(speed_str, "Speed: %d", speed);
        LCD_ShowString(0, 20, 200, 16, 16, speed_str);

		delay_ms(10);	//没有按键按下的时�?
		if(key==KEY0_PRES)	//KEY0按下,则执行校准程�?
		{
			reset();
//			LCD_ShowPic(40,40,12,40,gImage_missile);
		}else if(key == KEY1_PRES ){
			if(mode == 0){
				mode = 1;
			}else{
				mode = 0;
			}
			reset();
		}
		i++;
		if(i%20==0){
			LED0=!LED0;
			timer = timer + 1;
		}
	}
}


/* USER CODE END PM */

/* Private variables ---------------------------------------------------------*/
SPI_HandleTypeDef hspi1;

UART_HandleTypeDef huart1;

/* USER CODE BEGIN PV */

/* USER CODE END PV */

/* Private function prototypes -----------------------------------------------*/
void SystemClock_Config(void);
static void MX_GPIO_Init(void);
static void MX_SPI1_Init(void);
static void MX_USART1_UART_Init(void);
/* USER CODE BEGIN PFP */

/* USER CODE END PFP */

/* Private user code ---------------------------------------------------------*/
/* USER CODE BEGIN 0 */

/* USER CODE END 0 */

/**
  * @brief  The application entry point.
  * @retval int
  */
int main(void)
{
  /* USER CODE BEGIN 1 */

  /* USER CODE END 1 */

  /* MCU Configuration--------------------------------------------------------*/

  /* Reset of all peripherals, Initializes the Flash interface and the Systick. */
  HAL_Init();

  /* USER CODE BEGIN Init */
  Stm32_Clock_Init(RCC_PLL_MUL9);   	//设置时钟,72M
	delay_init(72);               		//初始化延时函�?
//	uart_init(115200);					//初始化串�?
//	usmart_dev.init(84); 		  	  	//初始化USMART
	LED_Init();							//初始化LED
	KEY_Init();							//初始化按�?
	LCD_Init();							//初始化LCD
	tp_dev.init();				   		//触摸屏初始化
  /* USER CODE END Init */

  /* Configure the system clock */
  SystemClock_Config();

  /* USER CODE BEGIN SysInit */

  /* USER CODE END SysInit */

  /* Initialize all configured peripherals */
  MX_GPIO_Init();
  MX_SPI1_Init();
  MX_USART1_UART_Init();
  Random_Init(); // 初始化随机数生成器
  Init_Obstacles(); // 初始化障碍物
  if(mode == 0){
	PLAYER_WIDTH = 40;
	PLAYER_HEIGHT = 37;
  }else{
		PLAYER_WIDTH = 40;
		PLAYER_HEIGHT = 32;
  }
  player_x = (screen_width - button_width) / 2; // 人物起始位置（水平居中）
  player_y = screen_height - button_height - 10 - PLAYER_HEIGHT;   // 人物起始位置（靠近底部）
  /* USER CODE BEGIN 2 */
	LCD_ShowPic(player_x,player_y,PLAYER_WIDTH,PLAYER_HEIGHT,gImage_dinosaur);
   	Load_Drow_Dialog();
   	last_update_time = HAL_GetTick();
    rtp_test(); 					//电阻屏
  /* USER CODE END 2 */

  /* Infinite loop */
  /* USER CODE BEGIN WHILE */

    /* USER CODE END WHILE */

    /* USER CODE BEGIN 3 */
  /* USER CODE END 3 */
}

/**
  * @brief System Clock Configuration
  * @retval None
  */
void SystemClock_Config(void)
{
  RCC_OscInitTypeDef RCC_OscInitStruct = {0};
  RCC_ClkInitTypeDef RCC_ClkInitStruct = {0};

  /** Initializes the RCC Oscillators according to the specified parameters
  * in the RCC_OscInitTypeDef structure.
  */
  RCC_OscInitStruct.OscillatorType = RCC_OSCILLATORTYPE_HSE;
  RCC_OscInitStruct.HSEState = RCC_HSE_ON;
  RCC_OscInitStruct.HSEPredivValue = RCC_HSE_PREDIV_DIV1;
  RCC_OscInitStruct.HSIState = RCC_HSI_ON;
  RCC_OscInitStruct.PLL.PLLState = RCC_PLL_ON;
  RCC_OscInitStruct.PLL.PLLSource = RCC_PLLSOURCE_HSE;
  RCC_OscInitStruct.PLL.PLLMUL = RCC_PLL_MUL9;
  if (HAL_RCC_OscConfig(&RCC_OscInitStruct) != HAL_OK)
  {
    Error_Handler();
  }

  /** Initializes the CPU, AHB and APB buses clocks
  */
  RCC_ClkInitStruct.ClockType = RCC_CLOCKTYPE_HCLK|RCC_CLOCKTYPE_SYSCLK
                              |RCC_CLOCKTYPE_PCLK1|RCC_CLOCKTYPE_PCLK2;
  RCC_ClkInitStruct.SYSCLKSource = RCC_SYSCLKSOURCE_PLLCLK;
  RCC_ClkInitStruct.AHBCLKDivider = RCC_SYSCLK_DIV1;
  RCC_ClkInitStruct.APB1CLKDivider = RCC_HCLK_DIV2;
  RCC_ClkInitStruct.APB2CLKDivider = RCC_HCLK_DIV1;

  if (HAL_RCC_ClockConfig(&RCC_ClkInitStruct, FLASH_LATENCY_2) != HAL_OK)
  {
    Error_Handler();
  }
}

/**
  * @brief SPI1 Initialization Function
  * @param None
  * @retval None
  */
static void MX_SPI1_Init(void)
{

  /* USER CODE BEGIN SPI1_Init 0 */

  /* USER CODE END SPI1_Init 0 */

  /* USER CODE BEGIN SPI1_Init 1 */

  /* USER CODE END SPI1_Init 1 */
  /* SPI1 parameter configuration*/
  hspi1.Instance = SPI1;
  hspi1.Init.Mode = SPI_MODE_MASTER;
  hspi1.Init.Direction = SPI_DIRECTION_2LINES;
  hspi1.Init.DataSize = SPI_DATASIZE_8BIT;
  hspi1.Init.CLKPolarity = SPI_POLARITY_LOW;
  hspi1.Init.CLKPhase = SPI_PHASE_1EDGE;
  hspi1.Init.NSS = SPI_NSS_SOFT;
  hspi1.Init.BaudRatePrescaler = SPI_BAUDRATEPRESCALER_8;
  hspi1.Init.FirstBit = SPI_FIRSTBIT_MSB;
  hspi1.Init.TIMode = SPI_TIMODE_DISABLE;
  hspi1.Init.CRCCalculation = SPI_CRCCALCULATION_DISABLE;
  hspi1.Init.CRCPolynomial = 10;
  if (HAL_SPI_Init(&hspi1) != HAL_OK)
  {
    Error_Handler();
  }
  /* USER CODE BEGIN SPI1_Init 2 */

  /* USER CODE END SPI1_Init 2 */

}

/**
  * @brief USART1 Initialization Function
  * @param None
  * @retval None
  */
static void MX_USART1_UART_Init(void)
{

  /* USER CODE BEGIN USART1_Init 0 */

  /* USER CODE END USART1_Init 0 */

  /* USER CODE BEGIN USART1_Init 1 */

  /* USER CODE END USART1_Init 1 */
  huart1.Instance = USART1;
  huart1.Init.BaudRate = 115200;
  huart1.Init.WordLength = UART_WORDLENGTH_8B;
  huart1.Init.StopBits = UART_STOPBITS_1;
  huart1.Init.Parity = UART_PARITY_NONE;
  huart1.Init.Mode = UART_MODE_TX_RX;
  huart1.Init.HwFlowCtl = UART_HWCONTROL_NONE;
  huart1.Init.OverSampling = UART_OVERSAMPLING_16;
  if (HAL_UART_Init(&huart1) != HAL_OK)
  {
    Error_Handler();
  }
  /* USER CODE BEGIN USART1_Init 2 */

  /* USER CODE END USART1_Init 2 */

}

/**
  * @brief GPIO Initialization Function
  * @param None
  * @retval None
  */
static void MX_GPIO_Init(void)
{

  /* GPIO Ports Clock Enable */
  __HAL_RCC_GPIOD_CLK_ENABLE();
  __HAL_RCC_GPIOA_CLK_ENABLE();

}

/* USER CODE BEGIN 4 */

/* USER CODE END 4 */

/**
  * @brief  This function is executed in case of error occurrence.
  * @retval None
  */
void Error_Handler(void)
{
  /* USER CODE BEGIN Error_Handler_Debug */
  /* User can add his own implementation to report the HAL error return state */
  __disable_irq();
  while (1)
  {
  }
  /* USER CODE END Error_Handler_Debug */
}

#ifdef  USE_FULL_ASSERT
/**
  * @brief  Reports the name of the source file and the source line number
  *         where the assert_param error has occurred.
  * @param  file: pointer to the source file name
  * @param  line: assert_param error line source number
  * @retval None
  */
void assert_failed(uint8_t *file, uint32_t line)
{
  /* USER CODE BEGIN 6 */
  /* User can add his own implementation to report the file name and line number,
     ex: printf("Wrong parameters value: file %s on line %d\r\n", file, line) */
  /* USER CODE END 6 */
}
#endif /* USE_FULL_ASSERT */
